## CMakeLists.txt
```
cmake_minimum_required(VERSION 3.20.0)

list(APPEND EXTRA_DTC_OVERLAY_FILE ${CMAKE_CURRENT_SOURCE_DIR}/src/app.overlay)

list(APPEND DTS_ROOT ${CMAKE_CURRENT_SOURCE_DIR}/..) 
find_package(Zephyr REQUIRED)
project(my_zephyr_app)

add_subdirectory(drivers/our_driver)

target_sources(app PRIVATE src/main.cpp)
```

## Kconfig
```
menuconfig LED_SUBSYSTEM
    bool "LED Subsystem"
    default y

if LED_SUBSYSTEM

config APP_HEARTBEAT_PERIOD_MS
    int "Heartbeat period (ms)"
    range 100 2000
    default 500

endif 

source "Kconfig.zephyr"
rsource "drivers/our_driver/Kconfig"
```

## prj.conf
```kconfig
CONFIG_GPIO=y
CONFIG_LOG=y

CONFIG_LED_SUBSYSTEM=y
CONFIG_OUR_DRIVER=y
CONFIG_SENSOR=y
CONFIG_SHELL=y
```

## boards/app.overlay
```dts
// / {
//     aliases {
//         app_led= &green_led_2;
//     };
// };
```

## boards/nucleo_wl55jc.overlay
```dts
/ {
    leds {
        red_led_3: led_2 {
            gpios = <&gpiob 0xb GPIO_ACTIVE_HIGH >;
        };
    };

    aliases {
            led1 = &blue_led_1;   //* in deps/zephyr/boards/st/nucleo_wl55jc/nucleo_wl55jc.dts:68 */
            led2 = &red_led_3;    //* in deps/zephyr/boards
            app-led = &green_led_2;  //* in deps/zephyr/boards/st/nucleo_wl55jc/nucleo_wl55jc.dts:70 */
    };
};
```

## src/main.cpp
```c
#include <zephyr/drivers/gpio.h>
#include <zephyr/kernel.h>
#include <zephyr/logging/log.h>
#include <zephyr/drivers/sensor.h>
#include <zephyr/device.h>
#include "our_driver.h"


const struct device *const my_device = DEVICE_DT_GET(DT_NODELABEL(our_driver0));

LOG_MODULE_REGISTER(main, LOG_LEVEL_INF);



namespace {
    void test() {
        const struct device *const driver = DEVICE_DT_GET(DT_NODELABEL(our_driver0));
        struct sensor_value val;
        auto ret = sensor_channel_get(driver, SENSOR_CHAN_AMBIENT_TEMP, &val);
        LOG_INF("Channel ret %d", ret);
    }
}

int main(void)
{
    struct sensor_value val; 
    uint32_t timer_value = 500;

    test();
    
    if (!device_is_ready(my_device)) {
        LOG_ERR("Device our_driver0 not ready");
        return -ENODEV;
    }

    our_driver_set_timer(my_device, timer_value);

    while (1) {
        int ret = sensor_sample_fetch(my_device);
        if (ret < 0) {
            LOG_ERR("Failed to fetch sensor sample: %d", ret);
        }

        ret = our_driver_get_timer(my_device, &timer_value);

        if (ret == 0) {
            LOG_INF("Timer value retrieved: %u", timer_value);

        } else {
            LOG_ERR("Failed to retrieve timer value: %d", ret);
            timer_value = 500; // Default to 500 ms if retrieval fails
        }

        k_msleep(timer_value);

        ret = sensor_channel_get(my_device, SENSOR_CHAN_AMBIENT_TEMP, &val);
        if (ret < 0) {
            LOG_ERR("Failed to get sensor channel: %d", ret);
        }

        k_msleep(timer_value);
    }

    
    /*
    bool led_state = true;

    if (!gpio_is_ready_dt(&led)) return 0;

    if (gpio_pin_configure_dt(&led, GPIO_OUTPUT_ACTIVE) < 0) return 0;

    while (1) {
        if (gpio_pin_toggle_dt(&led) < 0) return 0;

        led_state = !led_state;
        LOG_INF("LED state: %s", led_state ? "ON" : "OFF");
        k_msleep(CONFIG_APP_HEARTBEAT_PERIOD_MS);
    }
    return 0;
    */
}
```
