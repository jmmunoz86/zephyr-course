/ {
    	aliases {
        	app-led= &green_led_2;
    	};

	our_driver0: our_driver{
		compatible = "our,driver";
		status = "okay";
		led-gpios = <&gpiob 0xb GPIO_ACTIVE_HIGH>; // &gpiob 0xb GPIO_ACTIVE_HIGH
	};

	our_driver1: our_driver1{
		compatible = "our,driver";
		status = "okay";
		led-gpios = <&gpiob 0xf GPIO_ACTIVE_HIGH>; // &gpiob 0xb GPIO_ACTIVE_HIGH
	};
};
