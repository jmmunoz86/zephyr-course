## app/drivers/our_driver/Kconfig
```kconfig
config OUR_DRIVER
    bool "Our Driver"
    default y
    depends on DT_HAS_OUR_DRIVER_ENABLED
    depends on SENSOR && GPIO
```

## boards/copied_board/Kconfig.copied_board
```kconfig
# Copyright (c) 2020 STMicroelectronics
# SPDX-License-Identifier: Apache-2.0

config BOARD_COPIED_BOARD
	bool "Copied Board"
	help
	  This is the Copied Board board configuration.
	select SOC_STM32WL55XX
```

## boards/copied_board/board.yml
```yaml
board:
  name: copied_board
  full_name: Copied Board
  vendor: iomico
  socs:
    - name: stm32wl55xx
```

## boards/scratch_board/Kconfig.scratch_board
```kconfig
config BOARD_SCRATCH_BOARD
	bool "Scratch Board"
	help
	  This is the Scratch Board configuration.
	select SOC_STM32WL55XX
```

## boards/scratch_board/board.yml
```yaml
board:
  name: scratch_board
  full_name: My Board from scratch
  vendor: iomico
  socs:
    - name: stm32wl55xx
```

## boards/scratch_board/scratch_board_defconfig
```kconfig
# enable uart driver
CONFIG_SERIAL=y

# enable GPIO
CONFIG_GPIO=y

# console
CONFIG_CONSOLE=y
CONFIG_UART_CONSOLE=y
```

## dts/bindings/our,driver.yaml
```yaml
description: Our LED driver
compatible: "our,driver"
include: base.yaml
properties:
  led-gpios:
    description: LED node
    type: phandle-array
    required: true
```
